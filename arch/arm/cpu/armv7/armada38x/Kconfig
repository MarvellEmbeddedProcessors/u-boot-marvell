## arch/arm/cpu/armv7/armada38x/Kconfig
```kconfig
if TARGET_ARMADA_38X

config SYS_CPU
	string
	default "armv7"

config SYS_BOARD
	string
	default "armada38x"

config SYS_VENDOR
	string
	default "mvebu"

config SYS_SOC
	string
	default "armada38x"

config SYS_CONFIG_NAME
	string
	default "armada38x"

endif
```

## arch/arm/cpu/armv7/armadalp/Kconfig
```kconfig
if TARGET_ARMADA_LP

config SYS_CPU
	string
	default "armv7"

config SYS_BOARD
	string
	default "armadalp"

config SYS_VENDOR
	string
	default "mvebu"

config SYS_SOC
	string
	default "armadalp"

config SYS_CONFIG_NAME
	string
	default "armadalp"

config PALLADIUM
	bool "Support palladium emulation"
	default y
endif
```

## arch/arm/cpu/armv8/armada3700/Kconfig
```kconfig
if TARGET_ARMADA_3700

config SYS_CPU
	string
	default "armv8"

config SYS_BOARD
	string
	default "armada3700"

config SYS_VENDOR
	string
	default "mvebu"

config SYS_SOC
	string
	default "armada3700"

config SYS_CONFIG_NAME
	string
	default "armada3700"

config ARMV8_PSCI
	bool
	default y


endif
```

## arch/arm/cpu/armv8/armada8k/Kconfig
```kconfig
if TARGET_ARMADA_8K

config SYS_CPU
	string
	default "armv8"

config SYS_BOARD
	string
	default "armada8k"

config SYS_VENDOR
	string
	default "mvebu"

config SYS_SOC
	string
	default "armada8k"

config SYS_CONFIG_NAME
	string
	default "armada8k"

config ARMV8_PSCI
	bool
	default y

endif
```

## arch/arm/cpu/armv8/armadalp/Kconfig
```kconfig
if TARGET_ARMADA_LP

config SYS_CPU
	string
	default "armv8"

config SYS_BOARD
	string
	default "armadalp"

config SYS_VENDOR
	string
	default "mvebu"

config SYS_SOC
	string
	default "armadalp"

config SYS_CONFIG_NAME
	string
	default "armadalp"

config ARMV8_PSCI
	bool
	default y

config PALLADIUM
	bool "Support palladium emulation"
	default n
	help
	  Choose this option to enable
	  Palladium support.
	  There are certain differences
	  between palladium and real SoC,
	  like Clock and PHY, this should
	  not be enabled for real SoC.

config MVEBU_SPL_A3700_GPIO
	bool "GPIO configuration for A3700 in SPL"
	depends on TARGET_ARMADA_LP
	default y
	help
	  Choose this option to enable GPIO
	  configuration for A3700 in SPL.
	  This will be removed later, and be
	  implemented by MPP/PIN-CTRL driver.

config MVEBU_A3700_IO_ADDR_DEC
	bool "Armada-3700 Address decoding support"
	depends on !MVEBU_SPL_DDR_OVER_PCI_SUPPORT
	default n
	help
	  Choose this option to add support
	  for Marvell Armada-3700 address decoding driver

config MVEBU_A3700_MISC_INIT
	bool "Armada-3700 miscellaneous initialization procedures support"
	default n
	help
	  Choose this option to add support
	  for Marvell Armada-3700 miscellaneous init procedures

config MVEBU_A3700_CLOCK
	bool "Armada-3700  clock support"
	default n
	help
	  Choose this option to support
	  Marvell Armada-3700 clock driver.
	  For the first stage all clocks will be enabled
	  by default.

endif
```

## arch/arm/cpu/mvebu-common/Kconfig
```kconfig
config MVEBU_SPL_DIFFRENT_BASE_ADDR
	bool "Use SPL different registers base address"
	depends on MVEBU && TARGET_ARMADA_38X
	default n
	help
	  Choose this option to enable setting of a different
	  registers base address at the SPL stage.

choice
	prompt "Flash for image"
	default MVEBU_SPI_BOOT
	depends on !ENV_IS_IN_BOOTDEV

config MVEBU_NAND_BOOT
	bool "NAND flash boot"
	depends on (MVEBU_NAND || NAND_PXA3XX)
	help
	  Enable boot from NAND

config MVEBU_SPI_BOOT
	bool "SPI flash boot"
	depends on MVEBU_SPI

config MVEBU_NOR_BOOT
	bool "NOR flash boot"
	depends on MVEBU_NOR
	help
	  Enable boot from NOR boot partition

config MVEBU_MMC_BOOT
	bool "eMMC flash boot"
	depends on (MVEBU_MMC || XENON_MMC)
	help
	  Enable boot from eMMC boot partition

config MVEBU_SATA_BOOT
	bool "SATA device boot"
	depends on MV_INCLUDE_SATA
	help
	  Enable boot from SATA device boot partition
	  For details about image placement on the
	  boot device please refer to the BootROM manual

endchoice

config SYS_MMC_ENV_PART
	int "eMMC Boot Partition"
	depends on MVEBU_MMC_BOOT
	default 1
	help
	  Set the eMMC boot partition to flash
	  the boot image to and for saving the
	  u-boot environment.
	  Partition 0 is used for the user data
	  and should not be selected for boot.
	  Partition 1 is named BOOT0 and partition 2
	  named BOOT1. These are the valid partitions
	  for usage as a boot device.

menu "NAND Boot Parameters"
depends on MVEBU_NAND_BOOT

config MVEBU_NAND_BLOCK_SIZE
	int "NAND Boot Page Size (KB)"
	default 256
	help
	  Set the nand boot device block size (in KB).
	  This parameter is used by Bootrom in order to
	  determine the location of bad blocks
	  markers.

config MVEBU_NAND_CELL_TYPE
	string "NAND Boot Cell Type (SLC/MLC)"
	default SLC
	help
	  Set the boot nand cell type (0 for SLC,
	  1 for MLC).
	  This parameter is used by bootrom in order
	  to determine the bad block marker location
	  within the block.
endmenu

config ENV_IS_IN_BOOTDEV
	bool "Boot-time Environment Selection"
	depends on (MVEBU_SPI || MVEBU_NAND)
	help
	  Choose this option to add support
	  for boot-time environment selection.
	  the boot-time environment is decided
	  according to the boot source value
	  in sample at reset register.

config MVEBU_TOOLS_SUPPORT
	bool "MVEBU tools functions for U-Boot"
	default y
	help
	  Choose this option to add support
	  for different tools function for
	  U-Boot/SPL code

if MVEBU_TOOLS_SUPPORT
source "arch/arm/cpu/mvebu-common/tools/Kconfig"
endif

config MVEBU_SYS_INFO
	bool "System info transmitted to u-boot"
	default y
	help
	  Choose this option to add support
	  for system information in u-boot.
	  If you want to transfer information
	  from spl to u-boot, you need to choose
	  this option.
```

## arch/arm/cpu/mvebu-common/tools/Kconfig
```kconfig
menu "Tools support"
depends on MVEBU_TOOLS_SUPPORT

config MVEBU_SPL_MEMORY_TEST
	bool "Memory test"
	depends on SPL
	default n
	help
	To add this option you need to edit the
	defconfig and add the following line:
	+S:CONFIG_MVEBU_SPL_MEMORY_TEST=y
	Choose this option to test the memory after
	DRAM initialization

config MVEBU_MEM_TEST_ITERATION
	int "Number of Iterations for Memory test"
	depends on MVEBU_SPL_MEMORY_TEST
	range 1 255
	default 2
	help
	  This option set the number of the
	  iterations for DRAM test in SPL code
	  the range of the iteration number
	  between 1-255

config MVEBU_MEM_TEST_START_ADDR
	hex "Start address for Memory test"
	depends on MVEBU_SPL_MEMORY_TEST
	default 0x100000
	help
	  This option set the start address
	  of the DRAM test in SPL code

config MVEBU_MEM_TEST_END_ADDR
	hex "End address for Memory test"
	depends on MVEBU_SPL_MEMORY_TEST
	default 0xB00000
	help
	  This option set the end address
	  of the DRAM test in SPL code
endmenu
```

## arch/arm/mach-cn10k/Kconfig
```kconfig
if ARCH_CN10K

choice
	prompt "CN10K board select"
	optional

config TARGET_CN10K_A
	bool "Marvell CN10K SoC A"

config TARGET_CNF10K_A
	bool "Marvell CN10K Fusion SoC A"

config TARGET_CNF10K_B
	bool "Marvell CN10K Fusion SoC B"

endchoice

config SYS_SOC
	string
	default "cn10k"

config SYS_PCI_64BIT
	bool
	default y

endif
```

## arch/arm/mach-mvebu/Kconfig
```kconfig
if ARCH_MVEBU

config ARMADA_32BIT
	bool
	select CPU_V7
	select SUPPORT_SPL
	select SPL_DM
	select SPL_DM_SEQ_ALIAS
	select SPL_OF_CONTROL
	select SPL_SIMPLE_BUS
	select BOARD_EARLY_INIT_F
	select ARCH_MISC_INIT

# ARMv7 SoCs...
config ARMADA_375
	bool
	select ARMADA_32BIT

config ARMADA_38X
	bool
	select ARMADA_32BIT

config ARMADA_XP
	bool
	select ARMADA_32BIT

# ARMv8 SoCs...
config ARMADA_3700
	bool
	select ARM64

# Armada 7K and 8K are very similar - use only one Kconfig symbol for both
config ARMADA_8K
	bool
	select ARM64
	select ARMADA_AP806
	select ARMADA_CP110

# Armada 8k plus
config ARMADA_8K_PLUS
	bool
	select ARM64
	select ARMADA_AP810
	select ARMADA_CP110

config ARMADA_AP806
	bool

config ARMADA_AP810
	bool

config ARMADA_CP110
	bool

# Armada PLL frequency (used for NAND clock generation)
config SYS_MVEBU_PLL_CLOCK
	int
	default "2000000000" if ARMADA_XP || ARMADA_3700 || ARMADA_8K || ARMADA_8K_PLUS
	default "1000000000" if ARMADA_38X || ARMADA_375

# Armada XP/38x SoC types...
config MV78230
	bool
	select ARMADA_XP

config MV78260
	bool
	select ARMADA_XP

config MV78460
	bool
	select ARMADA_XP

config 88F6820
	bool
	select ARMADA_38X

choice
	prompt "Armada XP/375/38x/3700/7K/8K/8KP board select"
	optional

config TARGET_CLEARFOG
	bool "Support ClearFog"
	select 88F6820

config TARGET_MVEBU_ARMADA_37XX
	bool "Support Armada 37xx platforms"
	select ARMADA_3700

config TARGET_DB_88F6720
	bool "Support DB-88F6720 Armada 375"
	select ARMADA_375

config TARGET_DB_88F6820_GP
	bool "Support DB-88F6820-GP"
	select 88F6820

config TARGET_DB_88F6820_AMC
	bool "Support DB-88F6820-AMC"
	select 88F6820

config TARGET_MVEBU_ARMADA_8K
	bool "Support Armada 7k/8k platforms"
	select ARMADA_8K
	select BOARD_LATE_INIT

config TARGET_MVEBU_ARMADA_8K_PLUS
	bool "Support Armada 8k Plus platforms"
	select ARMADA_8K_PLUS
	select BOARD_LATE_INIT

config TARGET_DB_MV784MP_GP
	bool "Support db-mv784mp-gp"
	select MV78460

config TARGET_DS414
	bool "Support Synology DS414"
	select MV78230

config TARGET_MAXBCM
	bool "Support maxbcm"
	select MV78460

config TARGET_THEADORABLE
	bool "Support theadorable Armada XP"
	select BOARD_LATE_INIT if USB
	select MV78260

endchoice

config SYS_BOARD
	default "clearfog" if TARGET_CLEARFOG
	default "mvebu_armada-37xx" if TARGET_MVEBU_ARMADA_37XX
	default "db-88f6720" if TARGET_DB_88F6720
	default "db-88f6820-gp" if TARGET_DB_88F6820_GP
	default "db-88f6820-amc" if TARGET_DB_88F6820_AMC
	default "mvebu_armada-8k" if TARGET_MVEBU_ARMADA_8K
	default "mvebu_armada-8k-plus" if TARGET_MVEBU_ARMADA_8K_PLUS
	default "db-mv784mp-gp" if TARGET_DB_MV784MP_GP
	default "ds414" if TARGET_DS414
	default "maxbcm" if TARGET_MAXBCM
	default "theadorable" if TARGET_THEADORABLE

config SYS_CONFIG_NAME
	default "clearfog" if TARGET_CLEARFOG
	default "mvebu_armada-37xx" if TARGET_MVEBU_ARMADA_37XX
	default "db-88f6720" if TARGET_DB_88F6720
	default "db-88f6820-gp" if TARGET_DB_88F6820_GP
	default "db-88f6820-amc" if TARGET_DB_88F6820_AMC
	default "mvebu_armada-8k" if TARGET_MVEBU_ARMADA_8K
	default "mvebu_armada-8k-plus" if TARGET_MVEBU_ARMADA_8K_PLUS
	default "db-mv784mp-gp" if TARGET_DB_MV784MP_GP
	default "ds414" if TARGET_DS414
	default "maxbcm" if TARGET_MAXBCM
	default "theadorable" if TARGET_THEADORABLE

config SYS_VENDOR
	default "Marvell" if TARGET_DB_MV784MP_GP
	default "Marvell" if TARGET_MVEBU_ARMADA_37XX
	default "Marvell" if TARGET_DB_88F6720
	default "Marvell" if TARGET_DB_88F6820_GP
	default "Marvell" if TARGET_DB_88F6820_AMC
	default "Marvell" if TARGET_MVEBU_ARMADA_8K
	default "Marvell" if TARGET_MVEBU_ARMADA_8K_PLUS
	default "solidrun" if TARGET_CLEARFOG
	default "Synology" if TARGET_DS414

config SYS_SOC
	default "mvebu"

menu "MVEBU Common SoC Utilities"
	depends on ARCH_MVEBU

config MVEBU_PALLADIUM
	bool "Build image for Palladium emulation platform"
	default false
	depends on TARGET_MVEBU_ARMADA_8K_PLUS || TARGET_MVEBU_ARMADA_8K
	help
	  Build an image for Palladium emulation
	  platform with different clock or
	  address configuration.
	  Supported for Armada-8k-plus and Armada-8k

config SECURED_MODE_IMAGE
	bool "Build image for trusted boot"
	default false
	depends on 88F6820
	help
	  Build an image that employs the ARMADA SoC's trusted boot framework
	  for securely booting images.

config SECURED_MODE_CSK_INDEX
	int "Index of active CSK"
	default 0
	depends on SECURED_MODE_IMAGE

config MVEBU_SYS_INFO
	bool "System info transmitted to u-boot"
	default n
	help
	  Choose this option to add support
	  for system information in u-boot.
	  If you want to transfer information
	  from spl to u-boot, you need to choose
	  this option.

config MVEBU_EFUSE_SUPPORT
	bool "eFuse support"
	depends on TARGET_MVEBU_ARMADA_37XX
	default n
	help
	  Choose this option to add support
	  for eFuse access driver and enable
	  mailbox for eFuse read/write actions

config ENV_IS_IN_BOOTDEV
	bool "Boot-time Environment Selection"
	depends on MVEBU_SPI_BOOT || MVEBU_NAND_BOOT
	help
	  Choose this option to add support
	  for boot-time environment selection.
	  the boot-time environment is decided
	  according to the boot source value
	  in sample at reset.

endmenu
endif
```

## arch/arm/mach-octeontx3/Kconfig
```kconfig
if ARCH_OCTEONTX3

choice
	prompt "OcteonTX3 board select"
	optional

config TARGET_OCTEONTX3_106XX
	bool "Marvell OcteonTX3 CN106XX"

endchoice

config SYS_SOC
	string
	default "octeontx3"

config SYS_PCI_64BIT
	bool
	default y

endif
```

## board/Marvell/cn10k/Kconfig
```kconfig
if TARGET_CN10K_A || TARGET_CN10K_B || TARGET_CNF10K_A || TARGET_CNF10K_B

config SYS_VENDOR
	string
	default	"Marvell"

config SYS_BOARD
	string
	default "cn10k"

config SYS_CONFIG_NAME
	default "cn10k_common"

endif
```

## board/Marvell/common/Kconfig
```kconfig
menu "MVEBU Development Board Utilities"
	depends on ARCH_MVEBU

config BOARD_CONFIG_EEPROM
	bool "Support configuration EEPROM"
	default n
	help
	  If this option is enabled, U-Boot will initialize
	  configuration EEPROM on board.
	  It will be enabled once the CMD_MVEBU_BOX_INFO or
	  MULTI_DT_FILE is enabled

endmenu
```

## board/Marvell/octeontx2/Kconfig
```kconfig
if TARGET_OCTEONTX2_95XX || TARGET_OCTEONTX2_96XX || TARGET_OCTEONTX2_LOKI || TARGET_OCTEONTX2_98XX || TARGET_OCTEONTX2_95MM

config SYS_VENDOR
	string
	default	"Marvell"

config SYS_BOARD
	string
	default "octeontx2"

config SYS_CONFIG_NAME
	default "octeontx2_common"

endif
```

## board/Marvell/octeontx3/Kconfig
```kconfig
if TARGET_OCTEONTX3_106XX

config SYS_VENDOR
	string
	default	"Marvell"

config SYS_BOARD
	string
	default "octeontx3"

config SYS_CONFIG_NAME
	default "octeontx3_common"

endif
```
