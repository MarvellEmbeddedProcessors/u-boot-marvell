## board/mvebu/Kconfig
```kconfig
source "arch/arm/cpu/armv8/armada8k/Kconfig"
source "arch/arm/cpu/armv7/armada38x/Kconfig"
source "arch/arm/cpu/armv8/armada3700/Kconfig"

config MVEBU
	bool "Support MVEBU devices"
	depends on $SYS_VENDOR="mvebu"
	default y

menu "Marvell Platform Options"
	depends on MVEBU

menu "Board Options"

config DEVEL_BOARD
	bool "Support MVEBU development boards"
	depends on MVEBU
	default n
	---help---
	  Say Y here to add support for Marvell MVEBU
	  development boards.
	  You need this only if you work on a Marvell board.
	  If not, keep this off to reduce code size

source "board/mvebu/common/Kconfig"
endmenu

menu "Soc Options"

config MVEBU_FLC
	bool "Enable Final Level Cache (FLC) driver"
	depends on !MVEBU_SPL_DDR_OVER_PCI_SUPPORT
	default n
	help
	  Choose this option to add support
	  for Final Level Cache for the Marvell McKinley
	  Memory Controller driver.
	  This driver enable FLC and open the FLC windows.

config AP806_Z_SUPPORT
	bool "Enable support for AP-806-Z1 & Z2"
	default n
	help
	  Choose this option to add support
	  for Marvell's AP-806-Z1/Z2 devices
	  This configurations controlls all sorts of fixes
	  relevant only for the Z1 & Z2 stepping of AP-806

config MVEBU_A3700_CLOCK
	bool "Armada-3700  clock support"
	depends on TARGET_ARMADA_3700
	default n
	help
	  Choose this option to support
	  Marvell Armada-3700 clock driver.
	  For the first stage all clocks will be enabled
	  by default.

config MVEBU_A3700_PM
	bool "Armada-3700 PM support"
	depends on TARGET_ARMADA_3700
	select MVEBU_A3700_AVS
	default n
	help
	  Choose this option to support
	  Marvell Armada-3700 power management.
	  This configuration set default PM settings
	  according to current DT and clock configuration.

config MVEBU_A3700_AVS
	bool "Armada-3700 AVS support"
	depends on TARGET_ARMADA_3700
	default n
	help
	  Choose this option to support
	  Marvell Armada-3700 Adaptive Voltage Scaling(AVS).
	  This configuration set default AVS settings
	  according to current DT and clock configuration.

config MVEBU_BOOTMODE_SWITCH_SUPPORT
	bool "Mvebu bootmode switch support"
	depends on DEVEL_BOARD && TARGET_ARMADA_3700
	default n
	help
	  For armada-3700 Z series DB board, the boot source is
	  switched to uart at the early stage of ATF, choose this
	  option to restore the boot source at the last stage before
	  reaching u-boot prompt. This mechanism is introduced
	  in order to fallback to uart mode automatically
	  when a mal-function bootloader image is present in flash.

choice
	depends on TARGET_ARMADA_3700
	prompt "CPU and DDR Clock preset"
	default PRESET_CPU_800_DDR_800

config PRESET_CPU_600_DDR_600
	bool "CPU at 600 MHz, DDR at 600 MHz"
	help
	  Run system with the following clock
	  tree configuration preset:
	  CPU at 600 MHz,
	  DDR3 at 600 MHz

config PRESET_CPU_800_DDR_800
	bool "CPU at 800 MHz, DDR at 800 MHz"
	help
	  Run system with the following clock
	  tree configuration preset:
	  CPU at 800 MHz,
	  DDR3 at 800 MHz

config PRESET_CPU_1000_DDR_800
	bool "CPU at 1000 MHz, DDR at 800 MHz"
	help
	  Run system with the following clock
	  tree configuration preset:
	  CPU at 1000 MHz,
	  DDR3 at 800 MHz

endchoice

endmenu

config PALLADIUM
	bool "Support palladium emulation"
	depends on TARGET_ARMADA_3700 || TARGET_ARMADA_8K
	default n
	help
	  Choose this option to enable
	  Palladium support.
	  There are certain differences
	  between palladium and real SoC,
	  like Clock and PHY, this should
	  not be enabled for real SoC.

source "arch/arm/cpu/mvebu-common/Kconfig"

endmenu
```

## board/mvebu/armada38x/Kconfig
```kconfig
menu "Armada 38x boards"
	depends on TARGET_ARMADA_38X

config ARMADA_38X_DB
	bool "Support Marvell Armada-38x DB board"
	depends on DEVEL_BOARD
	default y
	help
	  Choose this option to add
	  support for Marvell Armada-38x
	  DB board. Say N unless you really
	  work on this board

config ARMADA_38X_RD
	bool "Support Marvell Armada-38x RD board"
	depends on DEVEL_BOARD
	default y
	help
	  Choose this option to add
	  support for Marvell Armada-38x
	  RD board. Say N unless you really
	  work on this board

config ARMADA_38X_CUSTOMER
	bool "Support Marvell Armada-38x Customer board"
	depends on CUSTOMER_BOARD
	default y
	help
	  Choose this option to add
	  support for Marvell Armada-38x
	  Customer board. Say N unless you really
	  work on this board

endmenu
```

## board/mvebu/armada8k/Kconfig
```kconfig
menu "Armada 8k boards"
	depends on TARGET_ARMADA_8K

config APN_806_DB
	bool "Support Marvell Armada-8K DB board"
	depends on DEVEL_BOARD
	default y
	help
	  Choose this option to add
	  support for Marvell Armada-8K
	  DB board. Say N unless you really
	  work on this board

config ARMADA_70X0_DB
	bool "Support Marvell Armada-70x0 board"
	depends on DEVEL_BOARD
	help
	  Choose this option to add
	  support for Marvell Armada-70x0
	  DB board. Say N unless you really
	  work on this board

endmenu
```

## board/mvebu/armadalp/Kconfig
```kconfig
menu "Armada LP boards"
	depends on TARGET_ARMADA_LP

config ARMADA_LP_DB0
	bool "Support Marvell Armada-8K DB0 board"
	depends on DEVEL_BOARD
	default y
	help
	  Choose this option to add
	  support for Marvell Armada-LP
	  DB0 board. Say N unless you really
	  work on this board

config ARMADA_LP_DB1
	bool "Support Marvell Armada-8K DB1 board"
	depends on DEVEL_BOARD
	default y
	help
	  Choose this option to add
	  support for Marvell Armada-LP
	  DB1 board. Say N unless you really
	  work on this board

config ARMADA_LP_CUSTOMER
	bool "Support Marvell Armada-8K Customer board"
	depends on CUSTOMER_BOARD
	default y
	help
	  Choose this option to add
	  support for Marvell Armada-LP
	  Customer board. Say N unless you really
	  work on this board

endmenu
```

## board/mvebu/common/Kconfig
```kconfig
menu "Development Board Utilities"
	depends on DEVEL_BOARD

config MVEBU_SAR
	bool "Support MVEBU SAR Utility"
	default y
	help
	  Say Y here to add support for Sample
	  at Reset Utility. You need this only if
	  you work on a Marvell development board.
	  If not, keep this off to reduce code size

config MULTI_DT_FILE
	bool "Support multi DT files in U-boot image"
	depends on OF_CONTROL
	default y
	select BOARD_CONFIG_EEPROM
	help
	  If this option is enabled, U-Boot will support different DT files.
	  Each FDT has a fixed size, so to choose between them in u-boot,
	  it will be executerd by a jump of this fix size.
	  The u-boot separates between the DTB by the flavor/board id

config BOARD_CONFIG_EEPROM
	bool "Support configuration EEPROM"
	default n
	help
	  If this option is enabled, U-Boot will initialize
	  configuration EEPROM on board.
	  It will be enabled once the CMD_MVEBU_BOX_INFO or
	  MULTI_DT_FILE is enabled

endmenu
```

## cmd/marvell/Kconfig
```kconfig
menu "Marvell specific command line interface"

config CMD_FAILSAFE
	depends on ARCH_OCTEONTX2 || ARCH_CN10K
	bool "Command for supporting fail safe boot"
	help
	   Support for fail safe boot on Marvell's OcteonTX2 or CN10K platforms.
	   Disables forced secondary boot and reports if boot from
	   primary device was successful.

config CMD_ETH
	depends on NET_OCTEONTX2 || NET_CN10K
	bool "Command to change fec and phy-mod type"
	help
	   Support for change of fec and phy-mod type for some specific
	   LMAC modes on RVU PF [CGX] network interfaces on Marvell
	   OcteonTX2 platforms.

config CMD_SERDES_DIAGNOSTICS
	depends on ARCH_CN10K
	bool "Commands related to CN10K SerDes diagnostics"
	help
	   SerDes diagnostics tool used for CN10k platform. Supports
	   performing PRBS, setting Loopback mode and reading/writing
	   Tx/Rx tuning parameters.

config CMD_PHY_DIAGNOSTICS
	bool "Commands related to PHY diagnostics"
	help
	   Supports reading temperature, performing PRBS, setting Loopback and
	   reading/writing PHY registers.

config CMD_EFI_CMDS
	depends on ARCH_CN10K
	bool "EFI commands"
	help
	   Support to load EFI Application Images from Secure SPI Flash
	   on CN10K platforms.

config CMD_SWITCH_CMDS
	depends on ARCH_CN10K
	bool "Switch commands"
	help
	   Support command to configure switch ports on CN10K platforms.

config CMD_MDIO_DBG
	depends on ARCH_OCTEONTX2
	bool "PHY registers read/write support on mdio bus"
	help
	   Support to debug phy registers over MDIO bus using SMC interface
	   to ATF for RVU PF [CGX] network interfaces on Marvell OcteonTX2
	   platforms.

config CMD_ATTEST
	depends on ARCH_OCTEONTX2
	bool "Command for supporting Software Attestation"
	help
	   Support for Software Attestation on Marvell's OcteonTX2 platforms.
	   Displays Secure Boot software component version information.

config CMD_AVSSTATUS
	depends on ARCH_OCTEONTX2
	bool "Command for supporting setting AVS status"
	help
	   Support for setting AVS status.


config CMD_BOOTIMGUP
	depends on ARCH_OCTEONTX || ARCH_OCTEONTX2
	depends on MMC_OCTEONTX || SPI_FLASH
	bool "bootimgup"
	help
	  bootimgup command support

config CMD_BOOTIMGUP_CN10K
	depends on ARCH_CN10K
	bool "bootimgup"
	help
	  bootimgup command support

config CMD_BOOTIMGUP_CUST_SIG
	depends on CMD_BOOTIMGUP_CN10K
	depends on ARCH_CN10K
	bool "bootimgup_cust_sig"
	help
	 Custom signature support for the bootimgup command used by some
	 customers.

config CMD_BOOTIMGUP_BACKUP
	depends on CMD_BOOTIMGUP_CN10K
	depends on ARCH_CN10K
	bool "bootimgup_backup"
	help
	 Enable support for a backup image in the SPI NOR flash.  This
	 requires that the SPI NOR be at least 32MiB in size.

endmenu
```

## cmd/mvebu/Kconfig
```kconfig
menu "MVEBU commands"
depends on ARCH_MVEBU

config CMD_MVEBU_BUBT
	bool "bubt"
	default n
	help
	  bubt - Burn a u-boot image to flash
	  For details about bubt command please see the documentation
	  in doc/mvebu/cmd/bubt.txt

config CMD_MVEBU_PHY_FW_DOWNLOAD
	bool "phy_fw_down"
	depends on MVMDIO
	default n
	help
	  phy_fw_down - This command download
	  PHY firmware header to the PHY flash.
	  This command is used for Marvell PHYs
	  88X3220/88X3310

config CMD_MVEBU_TSEN
	bool "tsen"
	depends on MVEBU_THERMAL_SENSOR
	default y
	help
	  tsen - Display the SoC temperature
	  as read from the on chip thermal sensor

config CMD_MVEBU_HW_INFO
	bool "hw_info"
	select BOARD_CONFIG_EEPROM
	default n
	help
	  hw_info - load HW information such as board ID, PCB SLM number,
	  MAC addresses from EEPROM and apply them to environment variables.
	  And update the MAC address in FDT file for Linux.
	  When save the box information, it will be saved to EEPROM.

choice
	prompt "Flash for image"
	default MVEBU_SPI_BOOT

config MVEBU_NAND_BOOT
	bool "NAND flash boot"
	depends on NAND_PXA3XX
	help
	  Enable boot from NAND flash.
	  Allow usage of NAND flash as a target for "bubt" command
	  For details about bubt command please see the documentation
	  in doc/mvebu/cmd/bubt.txt

config MVEBU_SPI_BOOT
	bool "SPI flash boot"
	depends on SPI_FLASH
	help
	  Enable boot from SPI flash.
	  Allow usage of SPI flash as a target for "bubt" command
	  For details about bubt command please see the documentation
	  in doc/mvebu/cmd/bubt.txt

config MVEBU_MMC_BOOT
	bool "eMMC flash boot"
	depends on (MVEBU_MMC || MMC_SDHCI_XENON)
	help
	  Enable boot from eMMC boot partition
	  Allow usage of eMMC/SD device as a target for "bubt" command
	  For details about bubt command please see the documentation
	  in doc/mvebu/cmd/bubt.txt

endchoice

config MVEBU_UBOOT_DFLT_NAME
	string "Default image name for bubt command"
	default "flash-image.bin"
	help
	  This option should contain a default file name to be used with
	  MVEBU "bubt" command if the source file name is omitted

config CMD_MVEBU_RX_TRAINING
	bool "rx_training"
	depends on TARGET_MVEBU_ARMADA_8K
	default n
	help
	  Perform RX training sequence

config CMD_MVEBU_AVS
	bool "avs"
	depends on TARGET_MVEBU_ARMADA_8K || TARGET_MVEBU_ARMADA_8K_PLUS
	default y
	help
	  Set/Get the Adaptive Voltage Scaling (AVS) value

config CMD_MVEBU_MAP
	bool "map"
	depends on TARGET_MVEBU_ARMADA_8K || TARGET_MVEBU_ARMADA_8K_PLUS
	default y
	help
	  Dump address translation tables
config CMD_MVEBU_NAND_OEM
	bool "nand"
	depends on (TARGET_MVEBU_ARMADA_8K || TARGET_MVEBU_ARMADA_8K_PLUS || TARGET_DB_88F6820_AP) && CMD_NAND
	default y
	help
	  Introduction: NAND vendors conducts tests to verify if all blocks are
	  OK. In case of failure block, the NAND manufacturer will mark this
	  block as bad (BBM) by setting 0x00 somewhere in the spare area.
	  Moreover NAND manufacturer can pre-programmed the chip with provided
	  image using external burner.

	  Issue: Marvell NFC employ optimized cost/performance ECC mechanism.
	  This results in an unique ECC layout implementation. Marvell NFC sets
	  different layouts according to page size/ECC strength combinations.

	  Therefore after preparing image for the NAND manufacturer for board
	  with Marvell NFC, due to the layout differences used by Marvell NFC
	  and physical NAND chip layout, some valid data will be put on BBM
	  position.  This will result on false bad block indicator and will
	  affect the BBT which is created automatically (by U-Boot or Linux)
	  during first run.

	  To prevent from that kind of situations, the NAND oem command was
	  introduced.

	  The "prepare" part of the command runs once per device data partition
	  in NAND and prepares image which is next send to manufacturer. It
	  checks if under BBM position there is no data which could be then
	  mistakenly taken as a BBM. If so the data together with tracking
	  information is copied to "meta-data" partition and BBM position is
	  overwritten with good indicator.

	  The "restore" part of the command runs once per "prepared" partition
	  and restores its original data. It supposed to run on new boards, on
	  which the NAND manufacturer pre-programmed earlier prepared image.

endmenu
```
