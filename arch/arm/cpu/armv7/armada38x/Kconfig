## common/mvebu/Kconfig
```kconfig
menu "MVEBU commands"
depends on MVEBU

config CMD_MVEBU_MISC
	bool "map, remap, units, ir"
	default y
	help
	  map      - Display address decode windows
	  remap    - Remap the output address of a window
	  units	   - Display and modify active units
	  ir       - Reading and changing internal register values
	  resetenv - Reset the environment variables, and set to default

config CMD_MVEBU_SAR
	bool "SatR"
	depends on MVEBU_SAR
	default n
	help
	  SatR - Modify SOC's sample at reset (SAR) values

config CMD_MVEBU_FDT_CONFIG
	bool "fdt_config"
	depends on (DEVEL_BOARD && MULTI_DT_FILE)
	default n
	help
	  fdt_config - Modify SOC and board configuration

config CMD_MVEBU_MPP
	depends on (DEVEL_BOARD && MVEBU_MPP_BUS)
	bool "mpp, mppbus"
	default n
	help
	  mpp - Display or modify MPP values
	  mppbus - Display or modify MPP bus info

config CMD_MVEBU_BUBT
	bool "bubt"
	default n
	help
	  bubt - Burn a u-boot image to flash

config CMD_MVEBU_MSS_BOOT
	bool "mss_boot"
	depends on TARGET_ARMADA_8K
	default y
	help
	  mss_boot - Loads MSS code into CM3 ID RAM and release from reset

config CMD_MVEBU_TSEN
	bool "tsen"
	depends on MVEBU_THERMAL_SENSOR_28NM || MVEBU_THERMAL_SENSOR_28NM_V2
	default n
	help
	  tsen - Display the SoC temperature
	  as read from the on chip thermal sensor

config CMD_MVEBU_PHY_FW_DOWNLOAD
	bool "phy_fw_down"
	depends on MVEBU_MDIO
	default n
	help
	  phy_fw_down - this command download
	  PHY firmware header to the PHY flash
	  this command used for Marvell PHYs
	  88X3220/88X3310

config CMD_MVEBU_PHY_INDIRECT
	bool "phy_indirect"
	depends on MVEBU_PHY_INDIRECT
	default y
	help
	  phy_indirect - Access to PHY indirect registers

config CMD_MVEBU_HW_INFO
	bool "hw_info"
	depends on DEVEL_BOARD
	select BOARD_CONFIG_EEPROM
	default n
	help
	  hw_info - load HW information such as board ID, PCB SLM number,
	  MAC addresses from EEPROM and apply them to enviroment variables.
	  And update the MAC address in FDT file for Linux.
	  When save the box information, it will be saved to EEPROM.

config CMD_MVEBU_EFUSE
	bool "efuse"
	depends on MVEBU_EFUSE_SUPPORT
	default n
	help
	  eFuse - allow access to SoC eFuse (OTP) entries

endmenu
```

## configs/mvebu_apn806_defconfig
```kconfig
CONFIG_SYS_EXTRA_OPTIONS="ARM64"
CONFIG_ARM=y
CONFIG_TARGET_ARMADA_8K=y
CONFIG_CMD_BOOTD=y
CONFIG_CMD_RUN=y
CONFIG_CMD_EDITENV=y
CONFIG_CMD_SAVEENV=y
CONFIG_CMD_MEMORY=y
CONFIG_CMD_MEMTEST=y
CONFIG_CMD_LOADB=y
CONFIG_CMD_ECHO=y
CONFIG_CMD_NET=y
CONFIG_CMD_PING=y
CONFIG_CMD_TIME=y
CONFIG_CMD_MISC=y
CONFIG_CMD_TIMER=y
CONFIG_CMD_MVEBU_SAR=y
CONFIG_CMD_MVEBU_MPP=y
CONFIG_CMD_MVEBU_BUBT=y
CONFIG_CMD_MVEBU_TSEN=y
CONFIG_OF_CONTROL=y
CONFIG_OF_EMBED=y
CONFIG_DEFAULT_DEVICE_TREE="apn-806-db"
CONFIG_MVEBU_PCI=y
CONFIG_MVEBU_CCU=y
CONFIG_MVEBU_RFU=y
CONFIG_ENC28J60=y
CONFIG_SYS_NS16550=y
CONFIG_MVEBU_I2C=y
CONFIG_MVEBU_SPI=y
CONFIG_MVEBU_PINCTL=y
CONFIG_MVEBU_MPP_BUS=y
CONFIG_MVEBU_COMPHY_SUPPORT=y
CONFIG_MVEBU_THERMAL_SENSOR=y
CONFIG_MVEBU_THERMAL_SENSOR_28NM_V2=y
CONFIG_DEVEL_BOARD=y
# CONFIG_MULTI_DT_FILE is not set
CONFIG_BOARD_CONFIG_EEPROM=y
CONFIG_AP806_Z_SUPPORT=y
```

## configs/mvebu_apn806_dop_defconfig
```kconfig
CONFIG_SPL=y
CONFIG_SYS_EXTRA_OPTIONS="ARM64"
+S:CONFIG_ARM=y
+S:CONFIG_TARGET_ARMADA_8K=y
CONFIG_MVEBU_MPP_BUS=y
+S:CONFIG_MVEBU_SPL_DDR_OVER_PCI_SUPPORT=y
+S:CONFIG_MVEBU_SPL_DDR_OVER_PCI_SWITCH=y
+S:CONFIG_MVEBU_SPL_SAR_DUMP=y
+S:CONFIG_DEVEL_BOARD=y
+S:# CONFIG_MULTI_DT_FILE is not set
CONFIG_CMD_BOOTD=y
CONFIG_CMD_RUN=y
CONFIG_CMD_EDITENV=y
CONFIG_CMD_SAVEENV=y
CONFIG_CMD_MEMORY=y
CONFIG_CMD_MEMTEST=y
CONFIG_CMD_ECHO=y
CONFIG_CMD_NET=y
CONFIG_CMD_PING=y
CONFIG_CMD_TIME=y
CONFIG_CMD_MISC=y
CONFIG_CMD_TIMER=y
CONFIG_CMD_MVEBU_SAR=y
CONFIG_CMD_MVEBU_MPP=y
CONFIG_CMD_MVEBU_BUBT=y
CONFIG_CMD_MVEBU_TSEN=y
+S:CONFIG_OF_CONTROL=y
+S:CONFIG_OF_EMBED=y
+S:CONFIG_DEFAULT_DEVICE_TREE="apn-806-db-dop"
CONFIG_ENC28J60=y
+S:CONFIG_SYS_NS16550=y
CONFIG_MVEBU_I2C=y
CONFIG_MVEBU_SPI=y
CONFIG_MVEBU_PINCTL=y
+S:CONFIG_MVEBU_COMPHY_SUPPORT=y
CONFIG_MVEBU_THERMAL_SENSOR=y
CONFIG_MVEBU_THERMAL_SENSOR_28NM_V2=y
+S:CONFIG_MVEBU_MK6_SUPPORT=y
```

## configs/mvebu_apn806_pd_defconfig
```kconfig
CONFIG_SPL=y
CONFIG_SYS_EXTRA_OPTIONS="ARM64"
+S:CONFIG_ARM=y
+S:CONFIG_TARGET_ARMADA_8K=y
+S:CONFIG_PALLADIUM=y
CONFIG_MVEBU_CCU=y
CONFIG_MVEBU_RFU=y
CONFIG_MVEBU_MPP_BUS=y
+S:CONFIG_DEVEL_BOARD=y
+S:# CONFIG_MULTI_DT_FILE is not set
CONFIG_CMD_BOOTD=y
CONFIG_CMD_RUN=y
CONFIG_CMD_EDITENV=y
CONFIG_CMD_SAVEENV=y
CONFIG_CMD_MEMORY=y
CONFIG_CMD_MEMTEST=y
CONFIG_CMD_PCI=y
CONFIG_CMD_TIME=y
CONFIG_CMD_MISC=y
CONFIG_CMD_TIMER=y
CONFIG_CMD_MVEBU_MPP=y
+S:CONFIG_OF_CONTROL=y
+S:CONFIG_OF_EMBED=y
+S:CONFIG_DEFAULT_DEVICE_TREE="apn-806-pd"
+S:CONFIG_SYS_NS16550=y
CONFIG_MVEBU_PINCTL=y
+S:# CONFIG_MVEBU_SPL_DDR_SUPPORT is not set
```
