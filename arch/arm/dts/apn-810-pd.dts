/*
 * ***************************************************************************
 * Copyright (C) 2015 Marvell International Ltd.
 * ***************************************************************************
 * This program is free software: you can redistribute it and/or modify it
 * under the terms of the GNU General Public License as published by the Free
 * Software Foundation, either version 2 of the License, or any later version.
 *
 * This program is distributed in the hope that it will be useful,
 * but WITHOUT ANY WARRANTY; without even the implied warranty of
 * MERCHANTABILITY or FITNESS FOR A PARTICULAR PURPOSE.  See the
 * GNU General Public License for more details.
 *
 * You should have received a copy of the GNU General Public License
 * along with this program.  If not, see <http://www.gnu.org/licenses/>.
 * ***************************************************************************
 */

/dts-v1/;

#include <dt-bindings/gpio/armada-8k-gpio.h>
#include "apn-810.dtsi"

/ {
	model = "Marvell APN-810A0 Palladium";
	compatible = "marvell,apn-810-pd", "marvell,apn-810";

	memory {
		device_type = "memory";
		reg = <0x00000000 0x10000000 0 0>; /* 512 MB */
	};

};
