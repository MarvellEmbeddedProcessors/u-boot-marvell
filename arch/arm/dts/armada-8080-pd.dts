/*
 * Copyright (C) 2017 Marvell International Ltd.
 *
 * SPDX-License-Identifier:    GPL-2.0
 * https://spdx.org/licenses
 */

/*
 * Device Tree file for Marvell Armada 8080 Palladium.
 */

#include "armada-8080-pd.dtsi"

/ {
	model = "Marvell Armada 8xx0 PD board";
	compatible = "marvell,armada8080-pd", "marvell,armada8080",
		     "marvell,armada-ap810";

	chosen {
		stdout-path = "serial0:115200n8";
	};

	memory@00000000 {
		device_type = "memory";
		reg = <0x0 0x0 0x0 0x80000000>;
	};


};

&ap0_uart0 {
	status = "okay";
};
