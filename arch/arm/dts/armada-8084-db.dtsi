/*
 * Copyright (C) 2017 Marvell International Ltd.
 *
 * SPDX-License-Identifier:    GPL-2.0
 * https://spdx.org/licenses
 */

#include "armada-8084.dtsi" /* include SoC device tree */
#include "armada-8xx0-dev-info.dsti"

/ {
	model = "ARMADA-8084-DB";
	compatible = "marvell,armada-8084-db", "marvell,armada-8084";

};
