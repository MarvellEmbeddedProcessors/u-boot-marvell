/*
 * Copyright (C) 2018 Marvell International Ltd.
 *
 * SPDX-License-Identifier:    GPL-2.0
 * https://spdx.org/licenses
 */

#include "armada-8160.dtsi" /* include SoC device tree */
#include "armada-8xx0-dev-info.dsti"

/ {
	model = "ARMADA-8160-PD";
	compatible = "marvell,armada-8160-pd", "marvell,armada-8160";
};
