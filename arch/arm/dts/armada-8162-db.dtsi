/*
 * Copyright (C) 2018 Marvell International Ltd.
 *
 * SPDX-License-Identifier:    GPL-2.0
 * https://spdx.org/licenses
 */

#include "armada-8162.dtsi" /* include SoC device tree */
#include "armada-8xx0-dev-info.dsti"

/ {
	model = "ARMADA-8162-DB";
	compatible = "marvell,armada-8162-db", "marvell,armada-8162";
};
