/*
 * Copyright (C) 2017 Marvell International Ltd.
 *
 * SPDX-License-Identifier:    GPL-2.0
 * https://spdx.org/licenses
 */

/*
 * Device Tree file for the Armada 8xx0 SoC, made of one AP810 only.
 */

#include "armada-ap810.dtsi"

/ {
	model = "Marvell Armada 8xx0";
	compatible = "marvell,armada-8xx0", "marvell,armada-ap810";
};
