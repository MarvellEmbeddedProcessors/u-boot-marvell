## drivers/fuse/Kconfig
```kconfig
#
# EFUSE infrastructure and drivers
#

menu "EFUSE Support"

config MVEBU_EFUSE
	bool "Enable eFuse support"
	default n
	depends on HAVE_MVEBU_EFUSE
	help
	  This enable mvebu efuse driver.
	  It supports for reading and writing eFuses.
	  This efuse driver supports marvell
	  a38x and a7k/8k SoC chips.

config MVEBU_EFUSE_FAKE
	bool "Fake eFuse access (dry run)"
	default n
	depends on MVEBU_EFUSE
	help
	  This enables a "dry run" mode where eFuses are not really programmed.
	  Instead the eFuse accesses are emulated by writing to and reading
	  from a memory block.
	  This is can be used for testing prog scripts.
endmenu
```

## drivers/gpio/Kconfig
```kconfig
menu "GPIO Support"

config DM_GPIO
	bool "Enable Driver Model for GPIO drivers"
	depends on DM
	help
	  If you want to use driver model for GPIO drivers, say Y.
	  To use legacy GPIO drivers, say N.

config MVEBU_PINCTL
	bool "MVEBU Pin control support"
	default n
	help
	  Choose this option to add support
	  for pinctl driver. This drive implements
	  the lowlevel control that allows changing
	  the function of a multi purpose pin

config MVEBU_A3700_PINCTL
	bool "MVEBU Armada3700 Pin control support"
	default n
	help
	  Choose this option to add support
	  for Armada3700 pinctl driver. This drive implements
	  the lowlevel control that allows changing
	  the function of a multi purpose pin

config MVEBU_GPIO
	bool "MVEBU GPIO support"
	select DM_GPIO
	default n
	help
	  Choose this option to add
	  support for mvebu GPIO.
	  This drive implements the
	  high level interfaces of GPIO.

config MVEBU_MPP_BUS
	bool "MPP bus support"
	depends on (DEVEL_BOARD && (MVEBU_PINCTL || MVEBU_A3700_PINCTL))
	default n
	help
	  Choose this option to add support
	  for the mpp-bus driver. This driver
	  is used for enabling or disabling mpp
	  buses at runtime

config DM_PCA953X
	bool "PCA95[357]x, PCA9698, TCA64xx, and MAX7310 I/O ports"
	depends on DM_GPIO
	help
	  Say yes here to provide access to several register-oriented
	  SMBus I/O expanders, made mostly by NXP or TI.  Compatible
	  models include:

	  4 bits:	pca9536, pca9537

	  8 bits:	max7310, max7315, pca6107, pca9534, pca9538, pca9554,
			pca9556, pca9557, pca9574, tca6408, xra1202

	  16 bits:	max7312, max7313, pca9535, pca9539, pca9555, pca9575,
			tca6416

	  24 bits:	tca6424

	  40 bits:	pca9505, pca9698

	  Now, max 24 bits chips and PCA953X compatible chips are
	  supported
endmenu
```

## drivers/i2c/Kconfig
```kconfig
menu "I2C Support"

config HARD_I2C
	bool "Legacy I2C Support"
	default n
	help
	  Choose this option to enable
	  legacy I2C serial bus commands
	  and include the appropriate
	  I2C driver for the selected CPU.

config MVEBU_I2C
	bool "MVEBU I2C support"
	default n
	select CMD_I2C if !SPL_BUILD
	help
	  Choose this option to add
	  support for Marvell's MVEBU
	  I2C driver, which is used
	  by Armada8k and Armada38x.

config MVEBU_I2C_BRIDGE
	bool "MVEBU I2C BRIDGE support"
	default y
	depends on MVEBU_I2C
	help
	  Choose this option to add
	  support for Marvell's MVEBU
	  I2C BRIDGE driver, which is used
	  by Armada8k.

config I2C_MV
	bool "I2C support for armada100/armada3700"
	default n
	select CMD_I2C if !SPL_BUILD
	select HARD_I2C
	help
	  Choose this option to
	  add support for I2C
	  driver of Marvell's SoC
	  Armada100 and Armada3700.

config I2C_MV_PAD_REG
	bool "4 bytes pad between every two I2C registers"
	default y
	help
	  Choose this option to add
	  4 bytes pad between every
	  two I2C registers, it fits
	  some SoC like Armada100.

endmenu
```

## drivers/mdio/Kconfig
```kconfig
#
# MDIO infrastructure and drivers
#

menu "MDIO Support"

config DM_MDIO
	bool "Enable Driver Model for MDIO drivers"
	depends on DM
	help
	  Enable driver model for MDIO access.

config MVMDIO
	bool "Marvell MDIO interface support"
	depends on DM_MDIO
	select PHYLIB
	---help---
	  This driver supports the MDIO interface found in the network
	  interface units of the Marvell EBU SoCs (Kirkwood, Orion5x,
	  Dove, Armada 370, Armada XP, Armada 37xx and Armada7K/8K/8KP).

	  This driver is used by the MVPP2 and MVNETA drivers.
endmenu
```

## drivers/misc/Kconfig
```kconfig
menu "Misc drivers"

config MVEBU_MBUS_SKIP_DRAM_WIN
	bool "skip DRAM window configuration in MBUS driver"
	depends on MVEBU_MBUS
	default n
	help
	  Choose this option to skip DRAM window
	  configuration in MBUS driver.
	  For some Soc, DRAM MBUS window has to
	  be at the beginning, and could not be
	  configured by anyway (keep the default value).

config MVEBU_PHY_INDIRECT
	bool "Access to PHY indirect registers"
	depends on TARGET_ARMADA_8K
	default y
	help
	  Choose this option to add support
	  for PHY indirect access.
	  This driver initialize the IHB window.

config MVEBU_IHB_INIT
	bool "Initialize IHB configuration"
	depends on TARGET_ARMADA_8K
	default n
	help
	  Choose this option to add support
	  for IHB phy configuration init
	  enable this option when needed,
	  if device is connected over IHB

config MVEBU_CHIP_SAR
	bool "Chip sample at reset support"
	default y
	help
	  Enable support for chip level sample at reset
	  retreval functions.
	  These functions are used by various U-Boot drivers
	  and subsystem to discover the SoC sample at reset
	  configuration.

config MVEBU_SPL_CHIP_SAR_DUMP
	bool "Sample at reset dump (in SPL)"
	depends on SPL && MVEBU_CHIP_SAR
	default n
	help
	  To add this option you need to add it to the spl config
	  Choose this option to dump sample at
	  reset registers

config MVEBU_A3700_MISC_INIT
	bool "Armada-3700 miscellaneous initialization procedures support"
	depends on TARGET_ARMADA_3700
	default n
	help
	  Choose this option to add support
	  for Marvell Armada-3700 miscellaneous init procedures

endmenu

menu "Address Decoding"
depends on MVEBU

config MVEBU_CCU
	bool "CCU address decoding driver"
	default n
	depends on !MVEBU_SPL_DDR_OVER_PCI_SUPPORT && TARGET_ARMADA_8K
	help
	  Choose this option to add support
	  for CCU address decoding driver.
	  This driver initialize the CCU windows
	  only.

config MVEBU_AMB_ADEC
	bool "AXI MBUS address decoding driver"
	default n
	depends on TARGET_ARMADA_8K
	help
	  Choose this option to add support
	  for AXI MBUS address decoding driver.
	  This driver initialize the IOB windows
	  only.

config MVEBU_IOB
	bool "IOB address decoding driver"
	default n
	depends on TARGET_ARMADA_8K
	help
	  Choose this option to add support
	  for IOB address decoding driver.
	  This driver initialize the IOB windows
	  only.

config MVEBU_RFU
	bool "RFU address decoding driver"
	default n
	depends on !MVEBU_SPL_DDR_OVER_PCI_SUPPORT && TARGET_ARMADA_8K
	help
	  Choose this option to add support
	  for RFU address decoding driver.
	  This driver initialize the RFU windows
	  which come after the CCU window.

config MVEBU_MBUS
	bool "MBUS address decoding driver"
	depends on !MVEBU_SPL_DDR_OVER_PCI_SUPPORT
	default n
	help
	  Choose this option to add support
	  for MBUS address decoding driver.
	  This driver initialize the MBUS windows
	  only.

config MVEBU_A3700_IO_ADDR_DEC
	bool "Armada-3700 Address decoding support"
	depends on !MVEBU_SPL_DDR_OVER_PCI_SUPPORT && TARGET_ARMADA_3700
	default n
	help
	  Choose this option to add support
	  for Marvell Armada-3700 address decoding driver

endmenu
```

## drivers/mmc/Kconfig
```kconfig
config XENON_MMC
	bool "XENON MMC support"
	default n
	select CMD_MMC
	help
	  Choose this option to add support
	  for Marvell XENON MMC driver, using Marvell xenon_mmc.c
	  driver.
	  base address is configured under XENON_MMC_BASE
```

## drivers/mtd/spi-nand/Kconfig
```kconfig
menu "SPI NAND Support"

config DM_SPI_NAND_FLASH
	bool "Enable Driver Model for SPI NAND flash"
	depends on DM && DM_SPI
	help
	  Enable driver model for SPI NAND flash. The SPI NAND flash interfaces
	  (spi_nand_flash_probe(), spi_nand_flash_write(), etc.) is then
	  implemented by the SPI NAND flash uclass. There is one standard
	  SPI NAND flash driver which knows how to probe most chips
	  supported by U-Boot. The uclass interface is defined in
	  include/spi_flash.h, but is currently fully compatible
	  with the old interface to avoid confusion and duplication
	  during the transition parent. SPI and SPI NAND flash must be
	  enabled together (it is not possible to use driver model
	  for one and not the other).

config SPI_NAND
	bool "SPI NAND support"
	default n
	select CMD_SPI_NAND
	help
	  Choose this option to add support
	  for SPI NAND driver

config SPI_NAND_USE_SPI_NOR_RD_PROT
	bool "Use SPI NOR flash 03h/0bh read protocol"
	default n
	help
	  Micron M79A SPI NAND support implement 03h/0Bh command, as is done
	  with SPI NOR for compatibility.

config SPI_NAND_FLASH_MTD
	bool "SPI NAND Flash MTD support"
	default n
	depends on SPI_NAND
	help
	  Enable the MTD support for spi nand flash layer, this adapter is
	  for translating mtd_read/mtd_write commands into spi_flash_read
	  and write commands. It is not intended to use it within sf_cmd or
	  the SPI nand flash subsystem. Such an adapter is needed for
	  subsystems like UBI which can only operate on top of the MTD layer.

	  If unsure, say N

endmenu # menu "SPI NAND Support"
```

## drivers/net/Kconfig
```kconfig
menu "Network drivers"

config MVEBU_MDIO
	bool "MVEBU mdio driver"
	default n
	help
	  Choose this option to add support
	  for Marvell MDIO driver which add
	  SMI/XSMI read/write functions to read
	  from Marvell PHYs

config ENC28J60
	bool "ENC28J60 driver"
	default n
	help
	  Choose this option to add support
	  for eth-spi (enc28j60) which
	  enable receiving ethernet packets
	  using spi interface.

config PHYLIB
	bool "common phy libary"
	default n
	help
	  Choose this option to add support
	  for common phy libary which
	  includes some basic PHY util
	  that are widely used.

config MVNETA
	bool "marvell neta driver"
	default n
	select PHYLIB
	help
	  Choose this option to add support
	  for marvell neta eth driver which
	  enable RX/TX ethernet packets
	  using gbe interface on marvell SoC.

config MVEBU_NETA_BYPASS_DEC_WIN
	bool "bypass decode window of neta driver"
	depends on MVNETA
	default n
	help
	  Choose this option to bypass decode window configuration
	  of neta eth driver. For some marvell Soc, there are two
	  layers of decode window for GBE:
	  1. GbE Address window that resides inside the GBE unit.
	  2. Fabric address window which is located in the NIC400.
	  In this case, to simplify address decode window,
	  bypass the first layer of GBE decode window by
	  setting the first window to 4GB.

config PHY_MARVELL
	bool "marvell PHY driver"
	default n
	help
	  Choose this option to add support
	  for marvell PHY driver, which enables
	  PHY layer and initialization support
	  Supports general initialization for Alaska 88E1510/88E1518/88E1512

config MAX_NETA_PORT_NUM
	int "max port number in neta driver"
	depends on MVNETA
	default 2
	help
	  Define the max number of
	  ethernet ports that need
	  to be supported in marvell
	  neta driver.

config MVPP2X
	bool "marvell pp2x driver"
	default n
	select PHYLIB
	help
	  Choose this option to add support
	  for marvell pp2x eth driver which
	  enable RX/TX ethernet packets
	  using gbe interface on marvell SoC.

choice
	prompt "Packet Processor Version"
	depends on MVPP2X
	default MVPPV22
	help
	  There are 2 versions of marvell pp2x driver.
	  Different version apply to different SoCs.

	  Please select correct version for SoC.

config MVPPV21
	bool "PP21"
	help
	  Choose this option to add support
	  for marvell pp21 eth driver
	  using gbe interface on marvell SoC.
	  pp21 applies to A375 and Avanta LP.

config MVPPV22
	bool "PP22"
	help
	  Choose this option to add support
	  for marvell pp22 eth driver
	  using gbe interface on marvell SoC.
	  pp22 applies to A70xx and A80xx
endchoice

config MAX_MVPP2X_NUM
	int "max packet processor number in mvpp2x driver"
	depends on MVPP2X
	default 2
	help
	  Define the max number of
	  packet processor v2 that need
	  to be supported in marvell
	  mvpp2x driver.

config MAX_MVPP2X_PORT_NUM
	int "max number of ports connected to each packet processor v2"
	depends on MVPP2X
	default 3
	help
	  Define the max number of
	  ethernet ports that connected
	  to packet processor v2 in marvell
	  mvpp2x driver.
endmenu
```

## drivers/pci/Kconfig
```kconfig
menu "PCI Bus Support"

config MVEBU_PCI
	bool "PCIE support"
	default n
	select CMD_PCI
	help
	  Choose this option to add
	  support for MVEBU PCI driver

config MVEBU_ADVK_PCIE
	bool "PCIE support for MVEBU Aardvark PCIe 3 driver"
	default n
	select CMD_PCI
	help
	  Choose this option to support
	  MVEBU Aardvark PCIe 3 driver
	  based on Ardvark IP.
	  Ardvark supports X1 GEN 3

config DW_PCIE
	bool "Enable DesignWare PCIe3 driver"
	default n
	help
	  Enable designware IP for PCIe3 driver.

config MVEBU_DW_PCIE
	bool "Enable MVEBU DesignWare PCIe 3 driver"
	default n
	select DW_PCIE
	help
	  Enable MVEBU PCIe 3 drivers based on designware IP.

endmenu
```
