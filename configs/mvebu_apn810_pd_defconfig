## configs/mvebu_apn810_pd_defconfig
```kconfig
CONFIG_SYS_EXTRA_OPTIONS="ARM64"
CONFIG_ARM=y
CONFIG_TARGET_ARMADA_8K=y
CONFIG_CMD_BOOTD=y
CONFIG_CMD_RUN=y
CONFIG_CMD_EDITENV=y
CONFIG_CMD_SAVEENV=y
CONFIG_CMD_MEMORY=y
CONFIG_CMD_MEMTEST=y
CONFIG_CMD_TIME=y
CONFIG_CMD_MISC=y
CONFIG_CMD_TIMER=y
CONFIG_OF_CONTROL=y
CONFIG_OF_EMBED=y
CONFIG_DEFAULT_DEVICE_TREE="apn-810-pd"
# CONFIG_MVEBU_PHY_INDIRECT is not set
CONFIG_MVEBU_CCU=y
CONFIG_MVEBU_RFU=y
CONFIG_SYS_NS16550=y
# CONFIG_MVEBU_EFUSE_SUPPORT is not set
CONFIG_DEVEL_BOARD=y
# CONFIG_MVEBU_SAR is not set
# CONFIG_MULTI_DT_FILE is not set
CONFIG_PALLADIUM=y
# CONFIG_MVEBU_TOOLS_SUPPORT is not set
```

## configs/mvebu_armada3700_defconfig
```kconfig
CONFIG_SYS_EXTRA_OPTIONS="ARM64"
CONFIG_ARM=y
CONFIG_TARGET_ARMADA_3700=y
CONFIG_MVEBU_A3700_IO_ADDR_DEC=y
CONFIG_MVEBU_A3700_CLOCK=y
CONFIG_MVEBU_MPP_BUS=y
CONFIG_MVEBU_A3700_UART=y
CONFIG_XENON_MMC=y
CONFIG_DEVEL_BOARD=y
CONFIG_CMD_BDI=y
CONFIG_CMD_BOOTD=y
CONFIG_CMD_RUN=y
CONFIG_CMD_EDITENV=y
CONFIG_CMD_SAVEENV=y
CONFIG_CMD_MEMORY=y
CONFIG_CMD_ECHO=y
CONFIG_CMD_NET=y
CONFIG_CMD_PING=y
CONFIG_CMD_MII=y
CONFIG_CMD_MISC=y
CONFIG_CMD_GPIO=y
CONFIG_CMD_MVEBU_MPP=y
CONFIG_CMD_MVEBU_FDT_CONFIG=y
CONFIG_CMD_MVEBU_BUBT=y
CONFIG_CMD_MVEBU_HW_INFO=y
CONFIG_OF_CONTROL=y
CONFIG_OF_EMBED=y
CONFIG_DEFAULT_DEVICE_TREE="armada-3700-ddr3-db"
CONFIG_FDT_SIZE=0x1C00
CONFIG_DM=y
CONFIG_MVEBU_ADVK_PCIE=y
CONFIG_MV_INCLUDE_SATA=y
CONFIG_SCSI_AHCI_PLAT=y
CONFIG_MVEBU_MBUS=y
CONFIG_MVNETA=y
CONFIG_MVEBU_NETA_BYPASS_DEC_WIN=y
CONFIG_PHY_MARVELL=y
CONFIG_I2C_MV=y
# CONFIG_I2C_MV_PAD_REG is not set
CONFIG_MVEBU_SPI=y
CONFIG_MVEBU_PINCTL=y
CONFIG_MVEBU_GPIO=y
CONFIG_USB=y
CONFIG_USB_XHCI_HCD=y
CONFIG_MVEBU_COMPHY_SUPPORT=y
CONFIG_SHA256=y
CONFIG_SHA1=y
CONFIG_MVEBU_BOOTMODE_SWITCH_SUPPORT=y
CONFIG_MVEBU_MBUS_SKIP_DRAM_WIN=y
CONFIG_MVEBU_A3700_PM=y
```

## configs/mvebu_armada38x_defconfig
```kconfig
CONFIG_SPL=y
+S:CONFIG_ARM=y
+S:CONFIG_TARGET_ARMADA_38X=y
+S:CONFIG_MVEBU_SPL_DIFFRENT_BASE_ADDR=y
CONFIG_MVEBU_MPP_BUS=y
+S:CONFIG_DEVEL_BOARD=y
+S:# CONFIG_MULTI_DT_FILE is not set
CONFIG_CMD_BDI=y
CONFIG_CMD_BOOTD=y
CONFIG_CMD_RUN=y
CONFIG_CMD_EDITENV=y
CONFIG_CMD_SAVEENV=y
CONFIG_CMD_MEMORY=y
CONFIG_CMD_MEMTEST=y
CONFIG_CMD_LOADB=y
CONFIG_CMD_LOADS=y
CONFIG_CMD_FLASH=y
CONFIG_CMD_ECHO=y
CONFIG_CMD_NET=y
CONFIG_CMD_DHCP=y
CONFIG_CMD_NFS=y
CONFIG_CMD_PING=y
CONFIG_CMD_TIME=y
CONFIG_CMD_MISC=y
CONFIG_CMD_TIMER=y
CONFIG_CMD_MVEBU_MPP=y
CONFIG_CMD_MVEBU_BUBT=y
CONFIG_CMD_MVEBU_TSEN=y
+S:CONFIG_OF_CONTROL=y
+S:CONFIG_OF_EMBED=y
+S:CONFIG_DEFAULT_DEVICE_TREE="armada-385-db"
CONFIG_FDT_SIZE=0x1C00
CONFIG_MVEBU_PCI=y
CONFIG_MVEBU_NAND=y
CONFIG_NAND_PXA3XX=y
CONFIG_MVEBU_MBUS=y
+S:CONFIG_SYS_NS16550=y
+S:CONFIG_MVEBU_I2C=y
+S# CONFIG_MVEBU_I2C_BRIDGE is not set
CONFIG_MVEBU_SPI=y
CONFIG_MVEBU_PINCTL=y
+S:CONFIG_MVEBU_COMPHY_SUPPORT=y
CONFIG_MVEBU_THERMAL_SENSOR=y
```

## configs/mvebu_armada70x0_defconfig
```kconfig
CONFIG_SYS_EXTRA_OPTIONS="ARM64"
CONFIG_ARM=y
CONFIG_TARGET_ARMADA_8K=y
CONFIG_CMD_BOOTD=y
CONFIG_CMD_RUN=y
CONFIG_CMD_EDITENV=y
CONFIG_CMD_SAVEENV=y
CONFIG_CMD_MEMORY=y
CONFIG_CMD_MEMTEST=y
CONFIG_CMD_LOADB=y
CONFIG_CMD_NAND=y
CONFIG_CMD_PCI=y
CONFIG_CMD_ECHO=y
CONFIG_CMD_NET=y
CONFIG_CMD_PING=y
CONFIG_CMD_MII=y
CONFIG_CMD_TIME=y
CONFIG_CMD_MISC=y
CONFIG_CMD_TIMER=y
CONFIG_CMD_MVEBU_SAR=y
CONFIG_CMD_MVEBU_FDT_CONFIG=y
CONFIG_CMD_MVEBU_MPP=y
CONFIG_CMD_MVEBU_BUBT=y
CONFIG_CMD_MVEBU_TSEN=y
CONFIG_CMD_MVEBU_HW_INFO=y
CONFIG_OF_CONTROL=y
CONFIG_OF_EMBED=y
CONFIG_DEFAULT_DEVICE_TREE="armada-70x0-db_router"
CONFIG_DM=y
CONFIG_MVEBU_DW_PCIE=y
CONFIG_NAND_PXA3XX=y
CONFIG_SCSI_AHCI_PLAT=y
CONFIG_CP110_SATA_ADDR_WA=y
CONFIG_MVEBU_CCU=y
CONFIG_MVEBU_AMB_ADEC=y
CONFIG_MVEBU_IOB=y
CONFIG_MVEBU_RFU=y
CONFIG_MVEBU_MDIO=y
CONFIG_PHY_MARVELL=y
CONFIG_MVPP2X=y
CONFIG_SYS_NS16550=y
CONFIG_MVEBU_I2C=y
CONFIG_MVEBU_SPI=y
CONFIG_MVEBU_PINCTL=y
CONFIG_MVEBU_GPIO=y
CONFIG_MVEBU_MPP_BUS=y
CONFIG_USB=y
CONFIG_USB_XHCI_HCD=y
CONFIG_XENON_MMC=y
CONFIG_MVEBU_RTC=y
CONFIG_MVEBU_COMPHY_SUPPORT=y
CONFIG_MVEBU_THERMAL_SENSOR=y
CONFIG_MVEBU_THERMAL_SENSOR_28NM_V2=y
CONFIG_DEVEL_BOARD=y
# CONFIG_MVEBU_LLC_ENABLE is not set
CONFIG_ENV_IS_IN_BOOTDEV=y
```

## configs/mvebu_armada70x0_dop_defconfig
```kconfig
CONFIG_SPL=y
CONFIG_SYS_EXTRA_OPTIONS="ARM64"
+S:CONFIG_ARM=y
+S:CONFIG_TARGET_ARMADA_8K=y
+S:CONFIG_AP806_Z_SUPPORT=y
CONFIG_MVEBU_MPP_BUS=y
+S:CONFIG_MVEBU_SPL_DDR_OVER_PCI_SUPPORT=y
+S:CONFIG_MVEBU_SPL_SAR_DUMP=y
+S:CONFIG_DEVEL_BOARD=y
+S:# CONFIG_MULTI_DT_FILE is not set
CONFIG_CMD_BOOTD=y
CONFIG_CMD_RUN=y
CONFIG_CMD_EDITENV=y
CONFIG_CMD_SAVEENV=y
CONFIG_CMD_MEMORY=y
CONFIG_CMD_MEMTEST=y
CONFIG_CMD_LOADB=y
CONFIG_CMD_NAND=y
CONFIG_CMD_ECHO=y
CONFIG_CMD_NET=y
CONFIG_CMD_PING=y
CONFIG_CMD_MII=y
CONFIG_CMD_TIME=y
CONFIG_CMD_MISC=y
CONFIG_CMD_TIMER=y
CONFIG_CMD_MVEBU_SAR=y
CONFIG_CMD_MVEBU_MPP=y
CONFIG_CMD_MVEBU_BUBT=y
CONFIG_CMD_MVEBU_TSEN=y
+S:CONFIG_OF_CONTROL=y
+S:CONFIG_OF_EMBED=y
+S:CONFIG_DEFAULT_DEVICE_TREE="armada-7040-rz-db_dop"
CONFIG_NAND_PXA3XX=y
CONFIG_SCSI_AHCI_PLAT=y
CONFIG_CP110_SATA_ADDR_WA=y
CONFIG_MVEBU_MDIO=y
CONFIG_ENC28J60=y
CONFIG_PHYLIB=y
CONFIG_PHY_MARVELL=y
+S:CONFIG_SYS_NS16550=y
CONFIG_MVEBU_I2C=y
CONFIG_MVEBU_SPI=y
CONFIG_MVEBU_PINCTL=y
+S:CONFIG_MVEBU_COMPHY_SUPPORT=y
CONFIG_MVEBU_THERMAL_SENSOR=y
CONFIG_MVEBU_THERMAL_SENSOR_28NM_V2=y
# CONFIG_MVEBU_SPL_DDR_SUPPORT is not set
CONFIG_USB=y
CONFIG_USB_XHCI_HCD=y
```

## configs/mvebu_armada70x0_pd_defconfig
```kconfig
CONFIG_SPL=y
CONFIG_SYS_EXTRA_OPTIONS="ARM64"
+S:CONFIG_ARM=y
+S:CONFIG_TARGET_ARMADA_8K=y
CONFIG_CMD_BOOTD=y
CONFIG_CMD_RUN=y
CONFIG_CMD_EDITENV=y
CONFIG_CMD_SAVEENV=y
CONFIG_CMD_MEMORY=y
CONFIG_CMD_MEMTEST=y
CONFIG_CMD_NET=y
CONFIG_CMD_PING=y
CONFIG_CMD_TIME=y
CONFIG_CMD_MISC=y
CONFIG_CMD_TIMER=y
CONFIG_CMD_MVEBU_MPP=y
CONFIG_CMD_MVEBU_BUBT=y
+S:CONFIG_OF_CONTROL=y
+S:CONFIG_OF_EMBED=y
+S:CONFIG_DEFAULT_DEVICE_TREE="armada-70x0-pd"
# CONFIG_MVEBU_PHY_INDIRECT is not set
CONFIG_MVEBU_CCU=y
CONFIG_MVEBU_IOB=y
CONFIG_MVEBU_RFU=y
+S:CONFIG_SYS_NS16550=y
CONFIG_MVEBU_SPI=y
CONFIG_MVEBU_PINCTL=y
CONFIG_MVEBU_MPP_BUS=y
+S:# CONFIG_MVEBU_SPL_DDR_SUPPORT is not set
+S:CONFIG_DEVEL_BOARD=y
# CONFIG_MVEBU_SAR is not set
+S:# CONFIG_MULTI_DT_FILE is not set
# CONFIG_MVEBU_LLC_ENABLE is not set
CONFIG_PALLADIUM=y
# CONFIG_MVEBU_TOOLS_SUPPORT is not set
```

## configs/mvebu_armada8k_defconfig
```kconfig
CONFIG_SPL=y
CONFIG_SYS_EXTRA_OPTIONS="ARM64"
+S:CONFIG_ARM=y
+S:CONFIG_TARGET_ARMADA_8K=y
CONFIG_MVEBU_MPP=y
+S:CONFIG_SYS_NS16550=y
+S:CONFIG_MVEBU_MK6_SUPPORT=y
CONFIG_CMD_BOOTD=y
CONFIG_CMD_RUN=y
CONFIG_CMD_EDITENV=y
CONFIG_CMD_SAVEENV=y
CONFIG_CMD_MEMORY=y
CONFIG_CMD_TIME=y
CONFIG_CMD_MISC=y
CONFIG_CMD_TIMER=y
+S:CONFIG_OF_CONTROL=y
+S:CONFIG_OF_EMBED=y
+S:CONFIG_DEFAULT_DEVICE_TREE="armada-8k"
```

## configs/mvebu_armadalp_defconfig
```kconfig
CONFIG_SPL=y
CONFIG_SYS_EXTRA_OPTIONS="ARM64"
+S:CONFIG_ARM=y
+S:CONFIG_TARGET_ARMADA_LP=y
+S:CONFIG_MVEBU_A3700_IO_ADDR_DEC=y
+S:CONFIG_MVEBU_A3700_MISC_INIT=y
+S:CONFIG_MVEBU_A3700_CLOCK=y
+S:CONFIG_MVEBU_UART_ARLP=y
CONFIG_XENON_MMC=y
CONFIG_MVEBU_MPP_BUS=y
CONFIG_MVEBU_PINCTL=y
+S:CONFIG_DEVEL_BOARD=y
+S:# CONFIG_MULTI_DT_FILE is not set
CONFIG_CMD_BDI=y
CONFIG_CMD_BOOTD=y
CONFIG_CMD_RUN=y
CONFIG_CMD_EDITENV=y
CONFIG_CMD_SAVEENV=y
CONFIG_CMD_MEMORY=y
CONFIG_CMD_ECHO=y
CONFIG_CMD_NET=y
CONFIG_CMD_PING=y
CONFIG_CMD_MII=y
CONFIG_CMD_MVEBU_MPP=y
CONFIG_CMD_MVEBU_BUBT=y
+S:CONFIG_OF_CONTROL=y
+S:CONFIG_OF_EMBED=y
+S:CONFIG_DEFAULT_DEVICE_TREE="armada-lp-db"
CONFIG_MVEBU_ADVK_PCIE=y
CONFIG_MV_INCLUDE_SATA=y
CONFIG_SCSI_AHCI_PLAT=y
+S:CONFIG_MVEBU_MBUS=y
+S:CONFIG_MVEBU_MBUS_SPL_ONLY=y
CONFIG_MVNETA=y
CONFIG_MVEBU_NETA_BYPASS_DEC_WIN=y
CONFIG_PHY_MARVELL=y
+S:CONFIG_I2C_MV=y
+S:# CONFIG_I2C_MV_PAD_REG is not set
CONFIG_MVEBU_SPI=y
CONFIG_USB=y
CONFIG_USB_XHCI_HCD=y
+S:CONFIG_MVEBU_COMPHY_SUPPORT=y
+S:CONFIG_MVEBU_MK6_SUPPORT=y
+S:CONFIG_MVEBU_DLL_TUNE_SUPPORT=y
```

## configs/mvebu_armadalp_palladium_defconfig
```kconfig
CONFIG_SPL=y
CONFIG_SYS_EXTRA_OPTIONS="ARM64"
+S:CONFIG_ARM=y
+S:CONFIG_TARGET_ARMADA_LP=y
CONFIG_MVEBU_SPI=y
CONFIG_MVNETA=y
CONFIG_MVEBU_NETA_BYPASS_DEC_WIN=y
CONFIG_I2C_MV=y
CONFIG_I2C_MV_PAD_REG=n
+S:CONFIG_MVEBU_UART_ARLP=y
+S:CONFIG_DEVEL_BOARD=y
+S:CONFIG_SPL_DRIVERS_MISC_SUPPORT=y
+S:CONFIG_MVEBU_A3700_IO_ADDR_DEC=y
+S:CONFIG_MVEBU_MBUS=y
+S:CONFIG_MVEBU_MBUS_SPL_ONLY=y
CONFIG_MVEBU_ADVK_PCIE=y
CONFIG_CMD_BDI=y
CONFIG_CMD_SPI=y
CONFIG_CMD_BOOTD=y
CONFIG_CMD_RUN=y
CONFIG_CMD_EDITENV=y
CONFIG_CMD_SAVEENV=y
CONFIG_CMD_MEMORY=y
CONFIG_CMD_NET=y
CONFIG_CMD_PING=y
+S:CONFIG_OF_CONTROL=y
+S:CONFIG_OF_EMBED=y
+S:CONFIG_DEFAULT_DEVICE_TREE="armada-lp-palladium"
+S:CONFIG_MVEBU_COMPHY_SUPPORT=y
```

## configs/mvebu_mcbin-88f8040_defconfig
```kconfig
CONFIG_ARM=y
CONFIG_ARCH_MVEBU=y
CONFIG_SYS_MALLOC_F_LEN=0x2000
CONFIG_TARGET_MVEBU_ARMADA_8K=y
CONFIG_MVEBU_SYS_INFO=y
CONFIG_ENV_IS_IN_BOOTDEV=y
CONFIG_MVEBU_SAR=y
CONFIG_DEFAULT_DEVICE_TREE="armada-8040-mcbin"
CONFIG_SMBIOS_PRODUCT_NAME=""
CONFIG_AHCI=y
# CONFIG_SYS_MALLOC_CLEAR_ON_INIT is not set
CONFIG_SYS_CONSOLE_INFO_QUIET=y
# CONFIG_DISPLAY_CPUINFO is not set
CONFIG_ARCH_EARLY_INIT_R=y
CONFIG_BOARD_EARLY_INIT_F=y
CONFIG_HUSH_PARSER=y
CONFIG_SYS_PROMPT="Marvell>> "
# CONFIG_CMD_IMLS is not set
# CONFIG_CMD_FLASH is not set
CONFIG_CMD_MMC=y
CONFIG_CMD_PART=y
CONFIG_CMD_SF=y
CONFIG_CMD_SPI=y
CONFIG_CMD_I2C=y
CONFIG_CMD_USB=y
# CONFIG_CMD_FPGA is not set
CONFIG_CMD_GPIO=y
# CONFIG_CMD_SETEXPR is not set
CONFIG_CMD_DHCP=y
CONFIG_CMD_MII=y
CONFIG_CMD_PING=y
CONFIG_CMD_CACHE=y
CONFIG_CMD_TIME=y
CONFIG_CMD_REGULATOR=y
CONFIG_CMD_EXT4=y
CONFIG_CMD_EXT4_WRITE=y
CONFIG_CMD_FAT=y
CONFIG_CMD_FS_GENERIC=y
CONFIG_CMD_MVEBU_BUBT=y
CONFIG_CMD_MVEBU_HW_INFO=y
CONFIG_CMD_MVEBU_PHY_FW_DOWNLOAD=y
CONFIG_MAC_PARTITION=y
CONFIG_ISO_PARTITION=y
CONFIG_EFI_PARTITION=y
CONFIG_DEVRES=y
CONFIG_DM_SCSI=y
CONFIG_MVEBU_SCSI=y
CONFIG_BLOCK_CACHE=y
CONFIG_DM_GPIO=y
CONFIG_DM_I2C=y
CONFIG_SYS_I2C_MVTWSI=y
CONFIG_MISC=y
CONFIG_MVEBU_MCI_INDIRECT_ACCESS=y
CONFIG_DM_MMC=y
CONFIG_MMC_SDHCI=y
CONFIG_MMC_SDHCI_XENON=y
CONFIG_SPI_FLASH=y
CONFIG_SPI_FLASH_MACRONIX=y
CONFIG_SPI_FLASH_SPANSION=y
CONFIG_SPI_FLASH_STMICRO=y
CONFIG_SPI_FLASH_WINBOND=y
CONFIG_PHY_MARVELL=y
CONFIG_E1000=y
CONFIG_MVPP2=y
CONFIG_PCI=y
CONFIG_DM_PCI=y
CONFIG_PCIE_DW_MVEBU=y
CONFIG_MVEBU_COMPHY_SUPPORT=y
CONFIG_PINCTRL=y
CONFIG_PINCTRL_ARMADA_8K=y
CONFIG_DM_REGULATOR_FIXED=y
CONFIG_DM_RTC=y
CONFIG_MVEBU_RTC=y
# CONFIG_SPL_SERIAL_PRESENT is not set
CONFIG_DEBUG_UART=y
CONFIG_DEBUG_UART_BASE=0xf0512000
CONFIG_DEBUG_UART_CLOCK=200000000
CONFIG_DEBUG_UART_SHIFT=2
CONFIG_DEBUG_UART_ANNOUNCE=y
CONFIG_SYS_NS16550=y
CONFIG_DM_THERMAL=y
CONFIG_MVEBU_THERMAL_SENSOR_28NM=y
CONFIG_MVEBU_THERMAL_EXT_SENSOR_28NM=y
CONFIG_USB=y
CONFIG_DM_USB=y
CONFIG_USB_XHCI_HCD=y
CONFIG_USB_EHCI_HCD=y
CONFIG_USB_STORAGE=y
CONFIG_SMBIOS_MANUFACTURER=""
```

## configs/mvebu_pd_armada8kp_defconfig
```kconfig
CONFIG_ARM=y
CONFIG_ARCH_MVEBU=y
CONFIG_SYS_MALLOC_F_LEN=0x2000
CONFIG_TARGET_MVEBU_ARMADA_8K_PLUS=y
CONFIG_MVEBU_PALLADIUM=y
CONFIG_SMBIOS_PRODUCT_NAME=""
# CONFIG_SYS_MALLOC_CLEAR_ON_INIT is not set
CONFIG_SYS_CONSOLE_INFO_QUIET=y
# CONFIG_DISPLAY_CPUINFO is not set
CONFIG_ARCH_EARLY_INIT_R=y
CONFIG_BOARD_EARLY_INIT_F=y
CONFIG_HUSH_PARSER=y
CONFIG_SYS_PROMPT="Marvell>> "
# CONFIG_CMD_BOOTEFI is not set
# CONFIG_CMD_IMLS is not set
# CONFIG_CMD_FLASH is not set
CONFIG_CMD_PART=y
# CONFIG_CMD_FPGA is not set
# CONFIG_CMD_SETEXPR is not set
# CONFIG_CMD_NET is not set
# CONFIG_CMD_NFS is not set
CONFIG_CMD_CACHE=y
CONFIG_CMD_TIME=y
CONFIG_MAC_PARTITION=y
CONFIG_DOS_PARTITION=y
CONFIG_ISO_PARTITION=y
CONFIG_EFI_PARTITION=y
CONFIG_DEVRES=y
CONFIG_BLK=y
CONFIG_BLOCK_CACHE=y
CONFIG_MVMDIO=y
CONFIG_MISC=y
# CONFIG_MMC is not set
# CONFIG_SPL_SERIAL_PRESENT is not set
CONFIG_DEBUG_UART=y
CONFIG_DEBUG_UART_BASE=0xec512000
CONFIG_DEBUG_UART_CLOCK=200000000
CONFIG_DEBUG_UART_SHIFT=2
CONFIG_DEBUG_UART_ANNOUNCE=y
CONFIG_SYS_NS16550=y
CONFIG_REGEX=y
CONFIG_SMBIOS_MANUFACTURER=""
```

## drivers/block/Kconfig
```kconfig
menu "block device drivers"
config MV_INCLUDE_SATA
	bool "Include driver for mvebu SATA device"
	default n
	help
	  Choose this option to enable
	  driver for mvebu SATA device,
	  which is standard ahci.c and
	  could be based on PCIe or SATA
	  controller.

config SCSI_AHCI_PLAT
	bool "SATA device based on controller"
	default n
	help
	  Choose this option to enable
	  the SATA device driver that
	  based on directly on SATA
	  controller.

config CP110_SATA_ADDR_WA
	bool "Enable CP-110 SATA address WA"
	default n
	help
	  Choose this option to enable
	  the SATA address WA for CP-110
	  it fixes the bad offset of the port
	  registers relative to general registers
endmenu
```

## drivers/ddr/Kconfig
```kconfig
menu "DDR support"

config MVEBU_SPL_DDR_SUPPORT
	bool "DDR SPL support"
	depends on SPL
	default y
	help
	  Choose this option to add support
	  for DDR controllers driver. need to
	  choose one of the controllers in the
	  list below.

choice
	prompt "Controller static/dynamic select"

config MVEBU_STATIC_SUPPORT
	bool "Static DDR initialization"
	depends on MVEBU_SPL_DDR_SUPPORT
	help
	  Choose this option to add support
	  for static DDR initialization code,
	  init the DDR with out training.
	  to add this option to SPL code,
	  need to add +S:CONFIG_MVEBU_STATIC_SUPPORT to defconfig file

config MVEBU_DYNAMIC_SUPPORT
	bool "Dynamic DDR initialization"
	depends on MVEBU_SPL_DDR_SUPPORT
	help
	  Choose this option to add support
	  for dynamic DDR initialization code,
	  init the DDR with training.
	  to add this option to SPL code,
	  need to add +S:CONFIG_MVEBU_DYNAMIC_SUPPORT to defconfig file

endchoice

choice
	prompt "Controller select"

config MVEBU_DUNIT_SUPPORT
	bool "DUNIT controller support"
	depends on MVEBU_SPL_DDR_SUPPORT
	help
	  Choose this option to add support
	  for DUNIT controller.

config MVEBU_MK6_SUPPORT
	bool "MK6 controller support"
	depends on MVEBU_SPL_DDR_SUPPORT
	help
	  Choose this option to add support
	  for DDR code for MK6 controller
	  to add this option to SPL code,
	  need to add +S:CONFIG_MVEBU_MK6_SUPPORT to defconfig file

config MVEBU_DLL_TUNE_SUPPORT
	  bool "Support for DDR DLL tune"
	  depends on MVEBU_MK6_SUPPORT
	  help
	  Choose this option to add support
	  for DDR DLL tune procedure support


endchoice

config MVEBU_SPL_DDR_OVER_PCI_SUPPORT
	bool "DDR over PCIE support in SPL"
	depends on SPL
	default n
	select MVEBU_PCI
	help
	  To add this option need to edit the defconfig and add the following line:
	  +S:CONFIG_MVEBU_SPL_DDR_OVER_PCI_SUPPORT=y
	  Choose this option to add support
	  for DDR over PCIE support

config MVEBU_SPL_DDR_OVER_PCI_SWITCH
	bool "DDR over PCIE switch support in SPL"
	depends on MVEBU_SPL_DDR_OVER_PCI_SUPPORT
	default n
	help
	  Support DDR over PCIe switch, this should be selected in case the DDR
	  PCIe addon card (PCAC) is located over a pcie switch (The first port of the
	  switch).
	  To add this option need to edit the defconfig and add the following line:
	  +S:CONFIG_MVEBU_SPL_DDR_OVER_PCI_SWITCH=y

config DDR_OVER_PCI_SIZE
	int "size of DDR over PCI"
	depends on MVEBU_SPL_DDR_OVER_PCI_SUPPORT
	default  536870912
	help
	  Defines the size of DRAM over
	  on the PCI endpoint. Relvant
	  only when DDR over PCI is
	  used.
endmenu
```

## drivers/efuse/Kconfig
```kconfig
menu "eFuse support"

config MVEBU_EFUSE_SUPPORT
	bool "eFuse support"
	depends on (TARGET_ARMADA_3700 || TARGET_ARMADA_8K)
	default y
	help
	  Choose this option to add support
	  for eFuse access driver

endmenu
```
