## drivers/pinctrl/mvebu/Kconfig
```kconfig
if ARCH_MVEBU

config PINCTRL_ARMADA_37XX
	depends on ARMADA_3700
	bool "Armada 37xx pin control driver"
	help
	   Support pin multiplexing and pin configuration control on
	   Marvell's Armada-37xx SoC.

config PINCTRL_ARMADA_8K
	bool "Armada 7k/8k/8kp pin control driver"
	help
	   Support pin multiplexing and pin configuration control on
	   Marvell's Armada-8K and Armada-8k-plus SoCs.

endif
```

## drivers/rtc/Kconfig
```kconfig
menu "RTC Support"

config MVEBU_RTC
	bool "MVEBU RTC support"
	default n
	help
	  Choose this option to add
	  support for Marvell's MVEBU
	  RTC driver, which is used
	  by Armada8k.

endmenu
```

## drivers/serial/Kconfig
```kconfig
menu "Serial Driver"

config DM_SERIAL
	bool "Enable Driver Model for serial drivers"
	depends on DM
	help
	  If you want to use driver model for serial drivers, say Y.
	  To use legacy serial drivers, say N.

config SYS_NS16550
	bool "Support NS16550 for serial drivers"
	help
	  Choose this option to add support
	  for NS16550 serial driver.
	  Register base address is configured
	  by CONFIG_SYS_NS16550_COM.

config UNIPHIER_SERIAL
	bool "UniPhier on-chip UART support"
	depends on ARCH_UNIPHIER && DM_SERIAL
	help
	  Support for the on-chip UARTs on the Panasonic UniPhier platform.

config MVEBU_A3700_UART
	bool "UART support for Armada3700"
	default n
	help
	  Choose this option to add support
	  for UART driver on Armada3700, which
	  is not using COM1 NS16550 driver.
	  And base address is configured in FDT file.

endmenu
```

## drivers/spi/Kconfig
```kconfig
menu "SPI Support"

config DM_SPI
	bool "Enable Driver Model for SPI drivers"
	depends on DM
	help
	  If you want to use driver model for SPI drivers, say Y.
	  To use legacy SPI drivers, say N.

config MVEBU_SPI
	bool "MVEBU SPI support"
	default n
	select CMD_SF
	select CMD_SPI
	help
	  Choose this option to add support
	  for the MVEBU SPI controller

endmenu
```

## drivers/thermal/Kconfig
```kconfig
menu "Thermal Sensor driver"

config MVEBU_THERMAL_SENSOR
        bool "Enable Thermal Sensor Core driver"
	depends on MVEBU_THERMAL_SENSOR_28NM || MVEBU_THERMAL_EXT_SENSOR_28NM
        help
          This config enables thermal sensor core driver.
          This driver scans for thermal sensor units,
          and initializes them.
	  The config is enabled once one of the thermal
	  sensors drive is enabled.

config MVEBU_THERMAL_SENSOR_28NM
	bool "Enable Thermal Sensor 28NM driver"
	select MVEBU_THERMAL_SENSOR
	select CMD_MVEBU_TSEN
	help
	  Choose this option to add support for
	  thermal sensor 28nm driver.
	  This driver init the thermal sensor unit,
	  and read the tempreture from the unit.

config MVEBU_THERMAL_EXT_SENSOR_28NM
	bool "Enable Thermal External Sensor 28NM driver"
	select MVEBU_THERMAL_SENSOR
	select CMD_MVEBU_TSEN
	help
	  Choose this option to add support for
	  thermal external sensor 28nm driver.
	  This driver init the External thermal sensor unit,
	  and read the tempreture from the unit.
endmenu
```

## drivers/usb/host/Kconfig
```kconfig
#
# USB Host Controller Drivers
#
comment "USB Host Controller Drivers"

config USB_XHCI_HCD
	bool "xHCI HCD (USB 3.0) support"
	---help---
	  The eXtensible Host Controller Interface (xHCI) is standard for USB 3.0
	  "SuperSpeed" host controller hardware.

config USB_XHCI
	bool
	default USB_XHCI_HCD
	---help---
	  TODO: rename after most boards switch to Kconfig

config USB_XHCI_MVEBU
	bool "mvebu USB 3.0 support"
	default y
	depends on MVEBU && USB_XHCI_HCD
	---help---
	  Choose this option to add support
	  for USB 3.0 driver on mvebu SoCs,
	  which includes Armada8K, Armada3700
	  and other Armada family SoCs.

if USB_XHCI_HCD

endif

config USB_EHCI_HCD
	bool "EHCI HCD (USB 2.0) support"
	---help---
	  The Enhanced Host Controller Interface (EHCI) is standard for USB 2.0
	  "high speed" (480 Mbit/sec, 60 Mbyte/sec) host controller hardware.
	  If your USB host controller supports USB 2.0, you will likely want to
	  configure this Host Controller Driver.

	  EHCI controllers are packaged with "companion" host controllers (OHCI
	  or UHCI) to handle USB 1.1 devices connected to root hub ports.  Ports
	  will connect to EHCI if the device is high speed, otherwise they
	  connect to a companion controller.  If you configure EHCI, you should
	  probably configure the OHCI (for NEC and some other vendors) USB Host
	  Controller Driver or UHCI (for Via motherboards) Host Controller
	  Driver too.

	  You may want to read <file:Documentation/usb/ehci.txt>.

config USB_EHCI
	bool
	default USB_EHCI_HCD
	---help---
	  TODO: rename after most boards switch to Kconfig

if USB_EHCI_HCD

config USB_EHCI_MARVELL
	bool "MARVELL USB 2.0 support"
	default y
	depends on MVEBU
	---help---
	  Choose this option to add support
	  for USB 2.0 driver on mvebu SoCs,
	  which includes Armada3700 and
	  other Armada family SoCs.

config USB_EHCI_MARVELL_BYPASS_BRG_ADDR_DEC
	bool "Bypass MARVELL USB 2.0 bridge address decode setting"
	default n
	depends on USB_EHCI_MARVELL
	---help---
	  Choose this option to bypass configuration
	  for USB 2.0 bridge address decode
	  setting on certain mvebu SoCs.
	  Address decode configuration is needed for
	  Armada-XP, Armada-37x, Armada-38x and Armada-390
	  SoCs, while not needed by Armada-3700.

config USB_EHCI_MARVELL_SBUSCFG
	bool "MARVELL USB 2.0 sbuscfg setting"
	default n
	depends on USB_EHCI_MARVELL
	---help---
	  Choose this option to add support
	  for USB 2.0 sbuscfg setting on
	  certain mvebu SoCs, which includes
	  Armada-37xx SoCs.

config USB_EHCI_UNIPHIER
	bool "Support for Panasonic UniPhier on-chip EHCI USB controller"
	depends on ARCH_UNIPHIER
	default y
	---help---
	  Enables support for the on-chip EHCI controller on Panasonic
	  UniPhier SoCs.

endif
```

## lib/Kconfig
```kconfig
menu "Library routines"

config CC_OPTIMIZE_LIBS_FOR_SPEED
	bool "Optimize libraries for speed"
	help
	  Enabling this option will pass "-O2" to gcc when compiling
	  under "lib" directory.

	  If unsure, say N.

config HAVE_PRIVATE_LIBGCC
	bool

config USE_PRIVATE_LIBGCC
	bool "Use private libgcc"
	depends on HAVE_PRIVATE_LIBGCC
	help
	  This option allows you to use the built-in libgcc implementation
	  of U-boot instead of the one privided by the compiler.
	  If unsure, say N.

config SYS_HZ
	int
	default 1000
	help
	  The frequency of the timer returned by get_timer().
	  get_timer() must operate in milliseconds and this option must be
	  set to 1000.

config SHA256
	bool "hash_256"
	default n
	help
	  sha256 - Calculate hash values with hash_256 algorithm.
	  Enabling this option will use sha256 to calculate hash value
	  when codes try to call sha256_start,sha256_update and
	  sha256_finish functions.


config SHA1
	bool "hash_160"
	default n
	help
	  sha1 - Caculate hash values with hash_160 algorithm.
	  Enabling this option will use sha1 to calculate hash value
	  when codes try to call sha1_start,sha1_update and
	  sha1_finish functions.

endmenu
```
