; initialize system
diag 16001
SYStem.RESet

SYStem.CPU 88FR581V7
SYStem.MultiCore COREBASE 0xc2301000
SYStem.MultiCore MEMORYACCESSPORT 0
SYStem.MultiCore DEBUGACCESSPORT  1

system.mode attach

break

; set system settings according LE MMU
Data.Set C15:1 %LONG 0x00052078

BREAK.SELECT PROGRAM ONCHIP

;############DDR@800Mhz D-Unit configuration#############
print ""
print "Starting DRAM initialization:"
; dram init
d.s 0xD0001400 %LONG 0x7b004618 ;  DDR SDRAM Configuration Register
d.s 0xD0001404 %LONG 0x36300848 ;  Dunit Control Low Register - kw40 bit11 high
d.s 0xD0001408 %LONG 0x5315baab ;  DDR SDRAM Timing (Low) Register
d.s 0xD000140C %LONG 0x76411fcf ;  DDR SDRAM Timing (High) Register
d.s 0xD0001410 %LONG 0x15134440 ;  DDR SDRAM Address Control Register
d.s 0xD0001414 %LONG 0x00000700 ;  DDR SDRAM Open Pages Control Register
d.s 0xD0001424 %LONG 0x0160f399 ;  Dunit Control High Register ( 2 :1 - bits 15:12 = 0xD )
d.s 0xD0001428 %LONG 0x0001a940 ;  Dunit Control High Register
d.s 0xD000142C %LONG 0x014c5098 ;  Dunit Control High Register  ( 2:1 -  bit 29 = '1' )
d.s 0xD000147C %LONG 0x0000d771 ;

d.s 0xD0001494 %LONG 0x00030000 ;  DDR SDRAM ODT Control (Low) Register
d.s 0xD000149C %LONG 0x0000000f ;  DDR Dunit ODT Control Register

d.s 0xD00014a8 %LONG 0x00000000 ;
d.s 0xD00014cc %LONG 0x8001200c ;
d.s 0xD0001474 %LONG 0x30c ;

d.s 0xD0001538 %LONG 0x0000000b ;  Read Data Sample Delays Register
d.s 0xD000153C %LONG 0x0000000b ;  Read Data Ready Delay Register

d.s 0xD0001504 %LONG 0xFFFFFFF1 ;
d.s 0xD000150c %LONG 0xFFFFFFE5 ;
d.s 0xD0001514 %LONG 0xffffff9	;
d.s 0xD000151c %LONG 0x0xffffffd;

d.s 0xD00015D0 %LONG 0x00000070 ;  MR0
d.s 0xD00015D4 %LONG 0x00000046 ;  MR1
d.s 0xD00015D8 %LONG 0x00000218 ;  MR2
d.s 0xD00015DC %LONG 0x00000000 ;  MR3

d.s 0xD00015E0 %LONG 0x5		;
d.s 0xD00015E4 %LONG 0x203c18	;  ZQC Configuration Register
d.s 0xD00015EC %LONG 0xd9ff0029	;  DDR PHY

d.s 0xD00016A0 %LONG 0xe8243dfe ; ZNR / SPR
d.s 0xD00016A0 %LONG 0xe8280434 ; disable clamp	and Vref
d.s 0xD00016A0 %LONG 0xcc000008 ; Clock skew
d.s 0xD00016A0 %LONG 0xe8260cb2
d.s 0xD00016A0 %LONG 0xe8290000
d.s 0xD00016A0 %LONG 0xf810001f

d.s 0xD0001480 %LONG 0x00000001 ;  DDR SDRAM Initialization Control Register
WAIT 2.s

d.s 0xD0018000 %LONG 0x11		;

d.s 0xD00200e8 %LONG 0x0;
d.s 0xD0020184 %LONG 0x0FFFFFE1 ;
d.s 0xD00182e4 %LONG 0xfffdffff ;

print "Init Done Done;-)"

enddo


